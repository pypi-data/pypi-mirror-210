AUTOSAR XML (schema 00046)
package /Cluster
  can cluster Cluster0: baudrate=500000
    can physical channel Pch0
      frame Message1: id 0x5, can-addressing-mode=STANDARD
