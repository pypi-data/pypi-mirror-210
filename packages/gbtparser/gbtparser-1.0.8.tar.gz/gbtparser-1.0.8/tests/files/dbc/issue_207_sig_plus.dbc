VERSION ""

NS_ :

BS_:

BU_:

BO_ 1 myMsg: 8 Vector__XXX
 SG_ myExtraSigWithPlus : 8|8@1- (1,-128) [-128|+127] "" Vector__XXX
 SG_ myNormalSig : 0|8@1- (1,-128) [-128|127] "" Vector__XXX

BA_DEF_  "BusType" STRING ;
BA_DEF_DEF_  "BusType" "CAN";
